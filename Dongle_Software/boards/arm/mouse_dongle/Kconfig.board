## Dongle_Software/boards/arm/mouse_dongle/Kconfig.board
```kconfig
# Copyright (c) 2022 Nordic Semiconductor ASA
# SPDX-License-Identifier: Apache-2.0

config BOARD_MOUSE_DONGLE
	bool "mouse_dongle"
	depends on SOC_NRF52820_QDAA
```

## Dongle_Software/boards/arm/mouse_dongle/Kconfig.defconfig
```kconfig
# Copyright (c) 2022 Nordic Semiconductor ASA
# SPDX-License-Identifier: Apache-2.0

if BOARD_MOUSE_DONGLE

config BOARD
	default "mouse_dongle"

config BT_CTLR
   default BT

endif
```

## Dongle_Software/boards/arm/mouse_dongle/mouse_dongle_defconfig
```kconfig
# Copyright (c) 2022 Nordic Semiconductor ASA
# SPDX-License-Identifier: Apache-2.0

CONFIG_SOC_SERIES_NRF52X=y
CONFIG_SOC_NRF52820_QDAA=y
CONFIG_BOARD_MOUSE_DONGLE=y

# Enable MPU
CONFIG_ARM_MPU=y

# Enable hardware stack protection
CONFIG_HW_STACK_PROTECTION=y

# choose RTT console
CONFIG_UART_CONSOLE=n
CONFIG_USE_SEGGER_RTT=y
CONFIG_CONSOLE=y
CONFIG_RTT_CONSOLE=y

# General config
CONFIG_LOG=y
CONFIG_LOG_DEFAULT_LEVEL=3

# Use Internal RC Clock
CONFIG_CLOCK_CONTROL_NRF_K32SRC_RC=y

# Config GPIO
CONFIG_GPIO=y

# Config SPI Drivers
CONFIG_SPI=y
CONFIG_SPI_ASYNC=y

# Config Enhanced Shock Burst
CONFIG_ESB=y

# additional board options
CONFIG_GPIO_AS_PINRESET=y

CONFIG_PINCTRL=y
```

## Dongle_Software/build/Kconfig/Kconfig.shield
```kconfig
osource "d:/programming/projects/mousesoftware/dongle_software/boards/shields/*/Kconfig.shield"
osource "D:/Programming/CrossCompilers/ncs/v2.4.1/nrf/boards/shields/*/Kconfig.shield"
```

## Dongle_Software/build/Kconfig/Kconfig.shield.defconfig
```kconfig
osource "c:/Users/deslo/Documents/Projects/MouseSoftware/Dongle_Software/boards/shields/*/Kconfig.defconfig"
osource "C:/ncs/v2.3.0/nrf/boards/shields/*/Kconfig.defconfig"
```

## Dongle_Software/build_dev_board/Kconfig/Kconfig.shield
```kconfig
osource "c:/Users/deslo/Documents/Projects/MouseSoftware/Dongle_Software/boards/shields/*/Kconfig.shield"
osource "C:/Programming/ncs/v2.0.2/nrf/boards/shields/*/Kconfig.shield"
```

## Dongle_Software/dev_board/Kconfig/Kconfig.shield.defconfig
```kconfig
osource "d:/programming/projects/mousesoftware/dongle_software/boards/shields/*/Kconfig.defconfig"
osource "D:/Programming/CrossCompilers/ncs/v2.4.1/nrf/boards/shields/*/Kconfig.defconfig"
```

## Mouse_Software/boards/arm/mouse_board/Kconfig.board
```kconfig
# Copyright (c) 2022 Nordic Semiconductor ASA
# SPDX-License-Identifier: Apache-2.0

config BOARD_MOUSE_BOARD
	bool "mouse_board"
	depends on SOC_NRF52820_QDAA
```

## Mouse_Software/boards/arm/mouse_board/Kconfig.defconfig
```kconfig
# Copyright (c) 2022 Nordic Semiconductor ASA
# SPDX-License-Identifier: Apache-2.0

if BOARD_MOUSE_BOARD

config BOARD
	default "mouse_board"

config BT_CTLR
   default BT

config USB_DEVICE_VID
    hex
    default "0x1FFE"

config USB_DEVICE_PID
    hex
    default "0x220"

config CONFIG_USB_HID_POLL_INTERVAL_MS  
    int
    default 1

endif
```

## Mouse_Software/boards/arm/mouse_board/mouse_board_defconfig
```kconfig
# Copyright (c) 2022 Nordic Semiconductor ASA
# SPDX-License-Identifier: Apache-2.0

CONFIG_SOC_SERIES_NRF52X=y
CONFIG_SOC_NRF52820_QDAA=y
CONFIG_BOARD_MOUSE_BOARD=y

# Enable MPU
CONFIG_ARM_MPU=y

# Enable hardware stack protection
CONFIG_HW_STACK_PROTECTION=y

# choose RTT console
CONFIG_UART_CONSOLE=n
CONFIG_USE_SEGGER_RTT=y
CONFIG_CONSOLE=y
CONFIG_RTT_CONSOLE=y

# General config
CONFIG_LOG=y
CONFIG_LOG_DEFAULT_LEVEL=4

# Use Internal RC Clock
CONFIG_CLOCK_CONTROL_NRF_K32SRC_RC=y

# Config GPIO
CONFIG_GPIO=y

# Config SPI Drivers
CONFIG_SPI=y

# Config PMW3360 sensor 
CONFIG_SENSOR=y
CONFIG_PMW3360=y
CONFIG_PMW3360_CPI=400
# CONFIG_PMW3360_LOG_LEVEL_DBG=y

# Congifure QDEC Driver
CONFIG_QDEC_NRFX=y

# additional board options
CONFIG_GPIO_AS_PINRESET=y

CONFIG_PINCTRL=y
```

## Mouse_Software/build/Kconfig/Kconfig.shield
```kconfig
osource "c:/Users/deslo/Documents/Projects/Mouse_Software/boards/shields/*/Kconfig.shield"
osource "C:/Programming/ncs/v2.0.2/nrf/boards/shields/*/Kconfig.shield"
```

## Mouse_Software/build/Kconfig/Kconfig.shield.defconfig
```kconfig
osource "c:/Users/deslo/Documents/Projects/MouseSoftware/Mouse_Software/boards/shields/*/Kconfig.defconfig"
osource "C:/Programming/ncs/v2.0.2/nrf/boards/shields/*/Kconfig.defconfig"
```

## Mouse_Software/build/Mouse_Software/Kconfig/Kconfig.shield.defconfig
```kconfig
osource "d:/programming/projects/mousesoftware/mouse_software/boards/shields/*/Kconfig.defconfig"
osource "D:/Programming/CrossCompilers/ncs/v2.4.1/nrf/boards/shields/*/Kconfig.defconfig"
osource "D:/Programming/CrossCompilers/ncs/v2.4.1/nrf/boards/shields/*/Kconfig.defconfig"
```
